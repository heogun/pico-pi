## external/Config.in
```kconfig
source "$BR2_EXTERNAL_PICO8OS_PATH/package/pico8-hotkey/Config.in"
source "$BR2_EXTERNAL_PICO8OS_PATH/package/sdl-gamecontrollerdb/Config.in"

config BR2_PACKAGE_PICO8OS_SDL2_HIDAPI
	bool "SDL2 HIDAPI joystick drivers (PICO8-OS override)"
	depends on BR2_PACKAGE_SDL2
	depends on BR2_TOOLCHAIN_HAS_THREADS # libusb
	depends on BR2_TOOLCHAIN_GCC_AT_LEAST_4_9 # libusb
	select BR2_PACKAGE_LIBUSB
	help
	  Buildroot builds SDL2 with --disable-hidapi-joystick and
	  --disable-hidapi-libusb. This turns both back on: SDL then
	  talks to PlayStation, Switch, Xbox, Steam and other
	  controllers directly over hidraw/libusb (better button
	  mapping, Joy-Con pairs, GameCube USB adapter), on top of the
	  kernel drivers.
```

## external/package/pico8-hotkey/Config.in
```kconfig
config BR2_PACKAGE_PICO8_HOTKEY
	bool "pico8-hotkey"
	help
	  Force-restart a frozen PICO-8: press Ctrl+Alt+Backspace on a
	  keyboard or hold SELECT+START for 3 seconds on a gamepad.
```

## external/package/pico8os-tryboot/Config.in
```kconfig
config BR2_PACKAGE_PICO8OS_TRYBOOT
	bool "pico8os-tryboot"
	help
	  Set or clear the Raspberry Pi firmware's one-shot tryboot
	  flag (through /dev/vcio), so the next boot uses tryboot.txt
	  instead of config.txt. Used by pico8os-ota to boot a freshly
	  installed system slot once: if it hangs before the kernel
	  or init, a reset boots the previous slot again.
```

## external/package/sdl-gamecontrollerdb/Config.in
```kconfig
config BR2_PACKAGE_SDL_GAMECONTROLLERDB
	bool "sdl-gamecontrollerdb"
	help
	  Community SDL2 game controller mappings, so controllers SDL
	  does not know natively get the right button layout.

	  https://github.com/mdqinc/SDL_GameControllerDB
```
